## central_dev/build/Kconfig/boards/Kconfig.defconfig
```kconfig
# Load Zephyr board defconfig descriptions.
osource "G:/Zephyr_Projects/zephyr/boards/espressif/esp32_devkitc/Kconfig.defconfig"
```

## central_dev/build/Kconfig/boards/Kconfig.tmp
```kconfig
# Load Zephyr board Kconfig descriptions.
osource "G:/Zephyr_Projects/zephyr/boards/espressif/esp32_devkitc/Kconfig"
```
